VERSION ""

NS_ :

BS_:

BU_: EngineNode

BO_ 257 EngineData: 8 EngineNode
 SG_ RPM : 0|16@1+ (1,0) [0|65535] "rpm" Vector__XXX
 SG_ Temp : 16|8@1+ (1,-40) [-40|215] "degC" Vector__XXX

CM_ BO_ 257 "Engine status data on Channel 1";
