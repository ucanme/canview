VERSION ""

NS_ :

BS_:

BU_: BodyNode

BO_ 513 BodyStatus: 4 BodyNode
 SG_ DoorOpen : 0|1@1+ (1,0) [0|1] "" Vector__XXX
 SG_ WindowPos : 1|7@1+ (1,0) [0|100] "%" Vector__XXX

CM_ BO_ 513 "Body comfort data on Channel 2";
