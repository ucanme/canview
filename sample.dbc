VERSION ""

NS_ :

BS_:

BU_: DBG

BO_ 257 EngineStatus: 8 DBG
 SG_ EngineTemp : 0|8@1+ (1, -40) [0|215] "degC" DBG
 SG_ EngineRPM : 8|16@1+ (0.25, 0) [0|16000] "rpm" DBG

BO_ 456 GearboxStatus: 4 DBG
 SG_ CurrentGear : 0|4@1+ (1, 0) [0|15] "" DBG
 SG_ TransmissionTemp : 4|8@1+ (1, -40) [0|215] "degC" DBG
